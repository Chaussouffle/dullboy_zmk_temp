#include "layout.h"
#include "layers.h"
#include <behaviors.dtsi>
#include <dt-bindings/zmk/keys.h>
#include <dt-bindings/zmk/mouse.h>

/*
&combos {
    compatible = "zmk,combos";

    c_acc_space_majacc {
        timeout-ms = <50>;
        slow-release;
        layers = <BASE>;
        key-positions = <8 36>;
        bindings = <&maj_acc>;
    };

    c_a_monav {
        timeout-ms = <25>;
        layers = <BASE>;
        key-positions = <19 36>;
        bindings = <&mo NAV_PRIME>;
        slow-release;
    };

    c_u_monav {
        timeout-ms = <25>;
        layers = <BASE>;
        key-positions = <10 33>;
        bindings = <&mo NAV_PRIME>;
        slow-release;
    };
};
*/
